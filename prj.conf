## CMakeLists.txt
```
#-------------------------------------------------------------------------------
# Zephyr Example Application
#
# Copyright (c) 2021 Nordic Semiconductor ASA
# SPDX-License-Identifier: Apache-2.0

cmake_minimum_required(VERSION 3.13.1)
find_package(Zephyr REQUIRED HINTS $ENV{ZEPHYR_BASE})

project(openthread_coap_client_server)

FILE(GLOB app_sources src/*.c)

target_sources(app PRIVATE ${app_sources})

zephyr_linker_sources(DATA_SECTIONS src/sections-ram.ld)

target_include_directories(app PRIVATE ${ZEPHYR_BASE}/subsys/net/ip)
```

## Kconfig
```
# Copyright (c) 2021 Nordic Semiconductor ASA
# SPDX-License-Identifier: Apache-2.0
#
# This file is the application Kconfig entry point. All application Kconfig
# options can be defined here or included via other application Kconfig files.
# You can browse these options using the west targets menuconfig (terminal) or
# guiconfig (GUI).

menu "Zephyr"
source "Kconfig.zephyr"
endmenu

module = APP
module-str = APP
source "${ZEPHYR_BASE}/subsys/logging/Kconfig.template.log_config"

module = OT_COAP_UTILS
module-str = OpenThread CoAP utils
source "${ZEPHYR_BASE}/subsys/logging/Kconfig.template.log_config"
```

## prj.conf
```kconfig
# Generic networking options
CONFIG_NETWORKING=y
CONFIG_REQUIRES_FULL_LIBC=y
CONFIG_NET_UDP=y

# Socket
CONFIG_NET_SOCKETS=y
CONFIG_POSIX_API=y
CONFIG_NET_SOCKETS_POLL_MAX=4

# CoAP
CONFIG_COAP=y
CONFIG_COAP_SERVER=y
CONFIG_COAP_SERVER_WELL_KNOWN_CORE=y
CONFIG_COAP_WELL_KNOWN_BLOCK_WISE=n

# Kernel options
CONFIG_ENTROPY_GENERATOR=y
CONFIG_TEST_RANDOM_GENERATOR=y

# Logging
CONFIG_PRINTK=y
CONFIG_NET_LOG=y
CONFIG_UART_LINE_CTRL=y

# Network Shell
CONFIG_NET_SHELL=y
CONFIG_COAP_SERVER_SHELL=y

# Configuration
CONFIG_NET_CONFIG_SETTINGS=y

# Events
CONFIG_NET_MGMT=y
CONFIG_NET_MGMT_EVENT=y
CONFIG_NET_MGMT_EVENT_INFO=y

# Enable only one protocol, if you enable both sources
# won't compile.
# IPv6 Support
CONFIG_NET_IPV6=y
CONFIG_NET_CONFIG_NEED_IPV6=y
CONFIG_NET_IF_MCAST_IPV6_ADDR_COUNT=5

#IPv4 Support
CONFIG_NET_IPV4=n
CONFIG_NET_CONFIG_NEED_IPV4=n
CONFIG_NET_CONFIG_MY_IPV4_ADDR=""

# Increased to fix failure push event error
CONFIG_NET_MGMT_EVENT_QUEUE_SIZE=10

# LwM2M Configuration
#CONFIG_LWM2M=y
```

## overlay-ot.conf
```kconfig
CONFIG_REQUIRES_FULL_LIBC=y

# Disable TCP and IPv4 (TCP disabled to avoid heavy traffic)
CONFIG_NET_TCP=n
CONFIG_NET_IPV4=n

CONFIG_NET_IPV6_NBR_CACHE=n
CONFIG_NET_IPV6_MLD=n
CONFIG_NET_CONFIG_NEED_IPV4=n
CONFIG_NET_CONFIG_MY_IPV4_ADDR=""
CONFIG_NET_CONFIG_PEER_IPV4_ADDR=""

CONFIG_SYSTEM_WORKQUEUE_STACK_SIZE=2048
CONFIG_MAIN_STACK_SIZE=3072

# Enable OpenThread shell
CONFIG_SHELL=y
CONFIG_OPENTHREAD_SHELL=y
CONFIG_SHELL_STACK_SIZE=3072

CONFIG_NET_L2_OPENTHREAD=y
CONFIG_OPENTHREAD_SLAAC=y

CONFIG_OPENTHREAD_DEBUG=y
CONFIG_OPENTHREAD_L2_DEBUG=y
CONFIG_OPENTHREAD_L2_LOG_LEVEL_INF=y

CONFIG_OPENTHREAD_JOINER=y
CONFIG_OPENTHREAD_JOINER_AUTOSTART=y

CONFIG_OPENTHREAD_FTD=y

#CONFIG_OPENTHREAD_CHANNEL=26
#CONFIG_OPENTHREAD_NETWORKKEY="00:11:22:33:44:55:66:77:88:99:aa:bb:cc:dd:ee:ff"

#CONFIG_NET_CONFIG_MY_IPV6_ADDR="fd46:7887:4656:4123:0:ff:fe00:e001"
#CONFIG_NET_CONFIG_PEER_IPV6_ADDR="fd73:13f6:c3ed:1:c508:231b:b9b7:cbc5"
CONFIG_NET_CONFIG_PEER_IPV6_ADDR="FD73:13F6:C3ED:1:8DA3:863F:A260:BAF7"

# mbedTLS tweaks
CONFIG_MBEDTLS_SSL_MAX_CONTENT_LEN=768

# A sample configuration to enable Thread Commissioner, uncomment if needed
#CONFIG_OPENTHREAD_COMMISSIONER=y

# Enable diagnostic module, uncomment if needed
CONFIG_OPENTHREAD_DIAG=y
```

## src/main.c
```c
/*
 * Copyright (c) 2021 Nordic Semiconductor ASA
 * SPDX-License-Identifier: Apache-2.0
 */

#include <zephyr/kernel.h>
#include <zephyr/logging/log.h>

LOG_MODULE_REGISTER(main, LOG_LEVEL_DBG);

#include <zephyr/net/net_ip.h>
#include <zephyr/net/socket.h>
#include <zephyr/net/udp.h>
#include <zephyr/net/coap.h>
#include <zephyr/net/coap_service.h>
#include <zephyr/net/coap_link_format.h>

#include <zephyr/drivers/gpio.h>
#include <zephyr/net/openthread.h>
#include <openthread/thread.h>

#include "coap_client.h"

// led0 -> Red LED
// led1 -> Green LED
// led2 -> Blue LED
// led3 -> Yellow LED
// led4 -> User LED
#define OT_CONNECTION_LED DT_ALIAS(led3)
#define PROVISIONING_LED DT_ALIAS(led1)
#define LIGHT_LED DT_ALIAS(led4)

#define COAP_SERVER_WORKQ_STACK_SIZE 1024
#define COAP_SERVER_WORKQ_PRIORITY 5

#define COAP_PORT 5683
#define SLEEP_TIME_MS 5000

K_THREAD_STACK_DEFINE(coap_server_workq_stack_area, COAP_SERVER_WORKQ_STACK_SIZE);

// LED initialization
static const struct gpio_dt_spec led_connection = GPIO_DT_SPEC_GET(OT_CONNECTION_LED, gpios);
static const struct gpio_dt_spec led_provisioning = GPIO_DT_SPEC_GET(PROVISIONING_LED, gpios);
static const struct gpio_dt_spec led_user = GPIO_DT_SPEC_GET(LIGHT_LED, gpios);

// Button initialization
static const struct gpio_dt_spec button = {DEVICE_DT_GET(DT_NODELABEL(gpio1)), 12, (GPIO_PULL_UP | GPIO_ACTIVE_LOW)};
enum button_evt {
    BUTTON_EVT_PRESSED,
    BUTTON_EVT_RELEASED
};
typedef void (*button_event_handler_t)(enum button_evt evt);
static button_event_handler_t button_cb;
static struct gpio_callback button_cb_data;

// CoAP Server Service Definition
COAP_SERVICE_DEFINE(coap_server, NULL, 5683, COAP_SERVICE_AUTOSTART);

/**
 * Function used to initialize the LEDs
 */
int init_leds()
{
	int ret;

	if (!gpio_is_ready_dt(&led_connection)) {
		LOG_ERR("Error: led device %s is not ready\n",
		       led_connection.port->name);
		return 0;
	}

	ret = gpio_pin_configure_dt(&led_connection, GPIO_OUTPUT_ACTIVE);
	if (ret < 0) {
		LOG_ERR("Error %d: failed to configure %s pin %d\n",
		       ret, led_connection.port->name, led_connection.pin);
		return 0;
	}

	if (!gpio_is_ready_dt(&led_provisioning)) {
		LOG_ERR("Error: led device %s is not ready\n",
		       led_provisioning.port->name);
		return 0;
	}

	ret = gpio_pin_configure_dt(&led_provisioning, GPIO_OUTPUT_ACTIVE);
	if (ret < 0) {
		LOG_ERR("Error %d: failed to configure %s pin %d\n",
		       ret, led_provisioning.port->name, led_provisioning.pin);
		return 0;
	}

	if (!gpio_is_ready_dt(&led_user)) {
		LOG_ERR("Error: led device %s is not ready\n",
		       led_user.port->name);
		return 0;
	}

	// Configure led_user as input and output pin at the same time so you can read the logical value
	// See: https://github.com/zephyrproject-rtos/zephyr/issues/48058
	ret = gpio_pin_configure_dt(&led_user, GPIO_INPUT | GPIO_OUTPUT_ACTIVE);
	if (ret < 0) {
		LOG_ERR("Error %d: failed to configure %s pin %d\n",
		       ret, led_user.port->name, led_user.pin);
		return 0;
	}

	if (!gpio_is_ready_dt(&button)) {
		LOG_ERR("Error: button device %s is not ready\n",
		       button.port->name);
		return 0;
	}

	return 0;
}

/**
 * Callback function for the delayable work item
 * Calls the actual button callback function
 */
static void cooldown_expired(struct k_work *work)
{
    ARG_UNUSED(work);

    int val = gpio_pin_get_dt(&button);
    enum button_evt evt = val ? BUTTON_EVT_PRESSED : BUTTON_EVT_RELEASED;
    if (button_cb) {
        button_cb(evt);
    }
}

/**
 * Macro to define a delayable work item with its corresponding handler
 */
static K_WORK_DELAYABLE_DEFINE(cooldown_work, cooldown_expired);

/**
 * Button callback function that sets the deadline for the work
 */
void button_pressed(const struct device *dev, struct gpio_callback *cb,
		    uint32_t pins)
{
	k_work_reschedule(&cooldown_work, K_MSEC(1000));
}

/**
 * Helper structure to turn a button event into a string
 */
static char *helper_button_evt_str(enum button_evt evt)
{
	switch (evt) {
	case BUTTON_EVT_PRESSED:
		return "Pressed";
	case BUTTON_EVT_RELEASED:
		return "Released";
	default:
		return "Unknown";
	}
}

/**
 * Button event handler
 * Callback function that is invoked on a button press
 * Sends CoAP requests to the Matter bridge as part of the PoC
 */
static void button_event_handler(enum button_evt evt)
{
	LOG_INF("Button event: %s\n", helper_button_evt_str(evt));
	int ret;

	ret = init_coap_client();
	if (ret < 0) {
		LOG_ERR("Couldn't start CoAP Client");
		goto end;
	}

	// Send a PUT request to the Toggle ressource
	ret = matter_on_off_toggle_put();
	if (ret < 0) {
		LOG_ERR("Couldn`t send PUT to Toggle");
		goto end;
	}

	// Wait 10 seconds
	k_msleep(10000);

	// Send a PUT request to the OnTime ressource containing the value to write
	ret = matter_on_off_ontime_put();
	if (ret < 0) {
		LOG_ERR("Couldn`t send PUT to OnTime");
		goto end;
	}

	// Wait 10 seconds
	k_msleep(10000);

	// Send a GET request to the OnOff ressource
	ret = matter_on_off_onoff_get();
	if (ret < 0) {
		LOG_ERR("Couldn`t send GET to OnOff");
		goto end;
	}

end:
	close_socket();
	LOG_INF("Closed CoAP Client");
}

/**
 * Function used to initialize the buttons
 */
int init_buttons(button_event_handler_t handler)
{
	int err = -1;

    if (!handler) {
        return -EINVAL;
    }

    button_cb = handler;

	if (!device_is_ready(button.port)) {
		return -EIO;
	}

	err = gpio_pin_configure_dt(&button, GPIO_INPUT);
	if (err) {
        return err;
	}

	err = gpio_pin_interrupt_configure_dt(&button, GPIO_INT_EDGE_BOTH);
	if (err) {
		return err;
	}

	gpio_init_callback(&button_cb_data, button_pressed, BIT(button.pin));
	err = gpio_add_callback(button.port, &button_cb_data);
    if (err) {
        return err;
    }

    return 0;
}

/**
 * GET request handler for the onoff resource
 */
static int on_off_object_state_get(struct coap_resource *resource, struct coap_packet *request,
                  struct sockaddr *addr, socklen_t addr_len)
{
	static const char *on_msg = "1";
	static const char *off_msg = "0";

    uint8_t data[CONFIG_COAP_SERVER_MESSAGE_SIZE];
    struct coap_packet response;
    uint16_t id;
    uint8_t token[COAP_TOKEN_MAX_LEN];
    uint8_t tkl, type;

    type = coap_header_get_type(request);
    id = coap_header_get_id(request);
    tkl = coap_header_get_token(request, token);

    /* Determine response type */
    type = (type == COAP_TYPE_CON) ? COAP_TYPE_ACK : COAP_TYPE_NON_CON;

    coap_packet_init(&response, data, sizeof(data), COAP_VERSION_1, type, tkl, token,
                     COAP_RESPONSE_CODE_CONTENT, id);

    /* Set content format */
    coap_append_option_int(&response, COAP_OPTION_CONTENT_FORMAT,
                           COAP_CONTENT_FORMAT_TEXT_PLAIN);

    /* Append payload */
    coap_packet_append_payload_marker(&response);
	
    if (gpio_pin_get_dt(&led_user)) {
		coap_packet_append_payload(&response, (uint8_t *)on_msg, sizeof(on_msg));
	} else {
		coap_packet_append_payload(&response, (uint8_t *)off_msg, sizeof(off_msg));
	}

    /* Send to response back to the client */
    return coap_resource_send(resource, &response, addr, addr_len, NULL);
}

/**
 * PUT request handler for the onoff resource
 */
static int on_off_object_state_put(struct coap_resource *resource, struct coap_packet *request,
                  struct sockaddr *addr, socklen_t addr_len)
{
	const uint8_t *data;
	uint16_t data_len;
    data = coap_packet_get_payload(request, &data_len);
	char converted_data[data_len];
	strcpy(converted_data, data);
	if (strncmp(converted_data, "0", 1) == 0) {
		LOG_INF("Disabling LED");
		gpio_pin_set_dt(&led_user, 0);
	} else if (strncmp(converted_data, "1", 1) == 0) {
		LOG_INF("Enabling LED");
		gpio_pin_set_dt(&led_user, 1);
	} else {
		LOG_INF("Invalid Payload");
		LOG_INF("Actual String: %s With Length: %i", converted_data, sizeof(converted_data));
		return COAP_RESPONSE_CODE_BAD_REQUEST;
	}

    return COAP_RESPONSE_CODE_CHANGED;
}

/**
 * Add the state ressource as a CoAP ressource
 */
static const char * const on_off_object_state_path[] = { "42769", "0", "1", NULL};
COAP_RESOURCE_DEFINE(on_off_object_state_resource, coap_server, {
    .path = on_off_object_state_path,
    .get = on_off_object_state_get,
	.put = on_off_object_state_put,
});

/**
 * PUT request handler for the on resource
 */
static int on_off_object_on_put(struct coap_resource *resource, struct coap_packet *request,
                  struct sockaddr *addr, socklen_t addr_len)
{
	gpio_pin_set_dt(&led_user, 1);
	return COAP_RESPONSE_CODE_CHANGED;
}

/**
 * Add the on ressource as a CoAP ressource
 */
static const char * const on_off_object_on_path[] = { "42769", "0", "2", NULL};
COAP_RESOURCE_DEFINE(on_off_object_on_resource, coap_server, {
    .path = on_off_object_on_path,
    .put = on_off_object_on_put,
});

/**
 * PUT request handler for the off resource
 */
static int on_off_object_off_put(struct coap_resource *resource, struct coap_packet *request,
                  struct sockaddr *addr, socklen_t addr_len)
{
	gpio_pin_set_dt(&led_user, 0);
	return COAP_RESPONSE_CODE_CHANGED;
}

/**
 * Add the off ressource as a CoAP ressource
 */
static const char * const on_off_object_off_path[] = { "42769", "0", "3", NULL};
COAP_RESOURCE_DEFINE(on_off_object_off_resource, coap_server, {
    .path = on_off_object_off_path,
    .put = on_off_object_off_put,
});

/**
 * PUT request handler for the switch ressource
 */
static int on_off_object_switch_put(struct coap_resource *resource, struct coap_packet *request,
                  struct sockaddr *addr, socklen_t addr_len)
{
	gpio_pin_toggle_dt(&led_user);
	return COAP_RESPONSE_CODE_CHANGED;
}

/**
 * Add the switch ressource as a CoAP ressource
 */
static const char * const on_off_object_switch_path[] = { "42769", "0", "4", NULL};
COAP_RESOURCE_DEFINE(on_off_object_switch_resource, coap_server, {
    .path = on_off_object_switch_path,
    .put = on_off_object_switch_put,
});

/**
 * Main function
 * This function initializes the LEDs as well as the buttons
 * Afterwards it waits for a button press
 */
int main(void)
{
	int ret;

	LOG_INF("Starting CoAP Server and CoAP Client");

	// Initialize the LEDs
	ret = init_leds();
	if (ret) {
		LOG_ERR("Could not initialize leds, err code: %d", ret);
		goto end;
	}

	// Initialize the buttons
	ret = init_buttons(button_event_handler);
	if (ret) {
		LOG_ERR("Cannot init buttons (error: %d)", ret);
		goto end;
	}

	// Endless loop to keep
	while (true)
	{
		k_msleep(SLEEP_TIME_MS);
	}
	
end:
	return 0;
}
```

## src/coap_client.c
```c
#include <zephyr/logging/log.h>
LOG_MODULE_REGISTER(coap_client, LOG_LEVEL_DBG);

#include <zephyr/net/socket.h>
#include <zephyr/net/udp.h>
#include <zephyr/net/coap.h>
#include "net_private.h"

#include "coap_client.h"

/* CoAP socket fd */
static int sock;

#define MAX_COAP_MSG_LEN 256

/**
 * Function used to handle a coap reply
 * Prints the response to a coap request
 */
static int process_simple_coap_reply(void)
{
	struct coap_packet reply;
	uint8_t *data;
	int rcvd;
	int ret;

	data = (uint8_t *)k_malloc(MAX_COAP_MSG_LEN);
	if (!data) {
		return -ENOMEM;
	}

	rcvd = recv(sock, data, MAX_COAP_MSG_LEN, MSG_DONTWAIT);
	if (rcvd == 0) {
		ret = -EIO;
		goto end;
	}

	if (rcvd < 0) {
		if (errno == EAGAIN || errno == EWOULDBLOCK) {
			ret = 0;
		} else {
			ret = -errno;
		}

		goto end;
	}

	net_hexdump("Response", data, rcvd);

	ret = coap_packet_parse(&reply, data, rcvd, NULL, 0);
	if (ret < 0) {
		LOG_ERR("Invalid data received");
	}

end:
	k_free(data);

	return ret;
}


/**
 * Function used to initialize the coap client
 */
int init_coap_client()
{
	int ret = 0;
	struct sockaddr_in6 addr6;

	addr6.sin6_family = AF_INET6;
	addr6.sin6_port = htons(COAP_PORT);
	addr6.sin6_scope_id = 0U;

	inet_pton(AF_INET6, CONFIG_NET_CONFIG_PEER_IPV6_ADDR,
		  &addr6.sin6_addr);

	sock = socket(addr6.sin6_family, SOCK_DGRAM, IPPROTO_UDP);
	if (sock < 0) {
		LOG_ERR("Failed to create UDP socket %d", errno);
		return -errno;
	}

	ret = connect(sock, (struct sockaddr *)&addr6, sizeof(addr6));
	if (ret < 0) {
		LOG_ERR("Cannot connect to UDP remote : %d", errno);
		return -errno;
	}

	return 0;
}

/**
 * Function used to send a PUT request to the Toggle ressource
 */
int matter_on_off_toggle_put(void)
{
	const char * const on_off_toggle_path[] = { "42770", "0", "8", NULL };
	struct coap_packet request;
	const char * const *p;
	uint8_t *data;
	int r;

	data = (uint8_t *)k_malloc(MAX_COAP_MSG_LEN);
	if (!data) {
		return -ENOMEM;
	}

	r = coap_packet_init(&request, data, MAX_COAP_MSG_LEN,
			     COAP_VERSION_1, COAP_TYPE_CON,
			     COAP_TOKEN_MAX_LEN, coap_next_token(),
			     COAP_METHOD_PUT, coap_next_id());
	if (r < 0) {
		LOG_ERR("Failed to init CoAP message");
		goto end;
	}

	for (p = on_off_toggle_path; p && *p; p++) {
		r = coap_packet_append_option(&request, COAP_OPTION_URI_PATH,
					      *p, strlen(*p));
		if (r < 0) {
			LOG_ERR("Unable add option to request");
			goto end;
		}
	}

	net_hexdump("Request", request.data, request.offset);

	r = send(sock, request.data, request.offset, 0);

end:
	k_free(data);

	return r;
}

/**
 * Function used to send a GET request to the OnOff ressource
 */
int matter_on_off_onoff_get()
{
	const char * const on_off_onoff_path[] = { "42770", "0", "5", NULL };
	struct coap_packet request;
	const char * const *p;
	uint8_t *data;
	int r;

	data = (uint8_t *)k_malloc(MAX_COAP_MSG_LEN);
	if (!data) {
		return -ENOMEM;
	}

	r = coap_packet_init(&request, data, MAX_COAP_MSG_LEN,
			     COAP_VERSION_1, COAP_TYPE_CON,
			     COAP_TOKEN_MAX_LEN, coap_next_token(),
			     COAP_METHOD_GET, coap_next_id());
	if (r < 0) {
		LOG_ERR("Failed to init CoAP message");
		goto end;
	}

	for (p = on_off_onoff_path; p && *p; p++) {
		r = coap_packet_append_option(&request, COAP_OPTION_URI_PATH,
					      *p, strlen(*p));
		if (r < 0) {
			LOG_ERR("Unable add option to request");
			goto end;
		}
	}

	net_hexdump("Request", request.data, request.offset);

	r = send(sock, request.data, request.offset, 0);

	r = process_simple_coap_reply();

end:
	k_free(data);

	return r;
}

/**
 * Function used to send a PUT request to the OnTime ressource
 */
int matter_on_off_ontime_put()
{
	uint8_t payload[] = "20";
	const char * const on_off_ontime_path[] = { "42770", "0", "3", NULL };
	struct coap_packet request;
	const char * const *p;
	uint8_t *data;
	int r;

	data = (uint8_t *)k_malloc(MAX_COAP_MSG_LEN);
	if (!data) {
		return -ENOMEM;
	}

	r = coap_packet_init(&request, data, MAX_COAP_MSG_LEN,
			     COAP_VERSION_1, COAP_TYPE_CON,
			     COAP_TOKEN_MAX_LEN, coap_next_token(),
			     COAP_METHOD_PUT, coap_next_id());
	if (r < 0) {
		LOG_ERR("Failed to init CoAP message");
		goto end;
	}

	for (p = on_off_ontime_path; p && *p; p++) {
		r = coap_packet_append_option(&request, COAP_OPTION_URI_PATH,
					      *p, strlen(*p));
		if (r < 0) {
			LOG_ERR("Unable add option to request");
			goto end;
		}
	}


	r = coap_packet_append_payload_marker(&request);
	if (r < 0) {
		LOG_ERR("Unable to append payload marker");
		goto end;
	}

	r = coap_packet_append_payload(&request, (uint8_t *)payload, sizeof(payload) - 1);
	if (r < 0) {
		LOG_ERR("Not able to append payload");
		goto end;
	}

	net_hexdump("Request", request.data, request.offset);

	r = send(sock, request.data, request.offset, 0);

end:
	k_free(data);

	return r;
}

/**
 * Function used to close the coap client socket
 */
int close_socket(void)
{
    /* Close the socket */
	(void)close(sock);
    return 0;
}
```

## src/coap_client.h
```c
#ifndef __OT_COAP_CLIENT_H__
#define __OT_COAP_CLIENT_H__

#define COAP_PORT 5683

/**
 * Function used to initialize the coap client
 */
int init_coap_client();

/**
 * Function used to send a PUT request to the Toggle ressource
 */
int matter_on_off_toggle_put();

/**
 * Function used to send a GET request to the OnOff ressource
 */
int matter_on_off_onoff_get();

/**
 * Function used to send a PUT request to the OnTime ressource
 */
int matter_on_off_ontime_put();

/**
 * Function used to close the coap client socket
 */
int close_socket();

#endif
```
